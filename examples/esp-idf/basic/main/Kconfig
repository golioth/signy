## examples/esp-idf/basic/main/Kconfig
```kconfig
# Copyright (c) 2025 Golioth, Inc.
#
# SPDX-License-Identifier: Apache-2.0

rsource '../../Kconfig'
```

## examples/esp-idf/ota/main/Kconfig
```kconfig
# Copyright (c) 2025 Golioth, Inc.
#
# SPDX-License-Identifier: Apache-2.0

rsource '../../Kconfig'

config SIGNY_EXAMPLE_WIFI_SSID
  string "SSID for Wi-Fi network"
  help
    SSID for Wi-Fi network.

config SIGNY_EXAMPLE_WIFI_PASSWORD
  string "Password for Wi-Fi network"
  help
    Password for Wi-Fi network.
```

## examples/esp-idf/ota/sdkconfig.defaults
```kconfig
CONFIG_ESPTOOLPY_FLASHSIZE_4MB=y
CONFIG_PARTITION_TABLE_TWO_OTA_LARGE=y
CONFIG_SPIRAM=y

CONFIG_SIGNY=y
```
